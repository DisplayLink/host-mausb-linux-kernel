## Kconfig
```kconfig
# SPDX-License-Identifier: GPL-2.0
#
# Kernel configuration file for MA-USB Host driver.
#
# Copyright (c) 2019 - 2020 DisplayLink (UK) Ltd.
#

config HOST_MAUSB
	tristate "MA-USB Host Driver"
	depends on USB=y
	default y
	help
		This is a MA-USB Host driver which enables host communication
		via MA-USB protocol stack.
```
